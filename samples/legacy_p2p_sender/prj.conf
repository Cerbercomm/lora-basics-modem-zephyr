## CMakeLists.txt
```
# My Cmake file
cmake_minimum_required(VERSION 3.20.0)

# We designate root dir to be a MODULE_EXT_ROOT (if/when this will accepted to the main zepher repo this wont be needed)
set(MODULE_EXT_ROOT ${CMAKE_CURRENT_LIST_DIR}/../..)

find_package(Zephyr REQUIRED HINTS $ENV{ZEPHYR_BASE})
project(bermad_tag)

# Target and source files
FILE(GLOB app_sources src/*.c)
target_sources(app PRIVATE ${app_sources})
```

## west.yml
```
# T2 west.yml, using manifest imports.
manifest:
  self:
    path: app

  remotes:
    - name: zephyrproject-rtos
      url-base: https://github.com/zephyrproject-rtos

  projects:
    - name: lora-basic-modem
      url: https://github.com/Lora-net/SWL2001
      path: modules/lib/lora-basics-modem
      revision: master
      
    - name: zephyr
      remote: zephyrproject-rtos
      revision: main
      import: true
```

## prj.conf
```kconfig
# We need to control GPIO pins
CONFIG_GPIO=y

# LoRa hardware is connected via SPI
CONFIG_SPI=y

# We need poll mechanism for legacy P2P LoRa
CONFIG_POLL=y

# We communicate with the operator through LoRa
CONFIG_LORA_BASICS_MODEM=y
CONFIG_LORA_BASICS_MODEM_P2P_API=y
CONFIG_LORA_BASICS_MODEM_LEGACY_P2P=y
```

## src/main.c
```c
#include <zephyr/kernel.h>
#include <zephyr/drivers/lora.h>

#include "rs485.h"

#include <zephyr/logging/log_ctrl.h>
#include <zephyr/logging/log.h>
LOG_MODULE_REGISTER(main);

#define MAX_DATA_LEN 10
char data[MAX_DATA_LEN] = {'h', 'h', 'i', 'O', 'r', '1', 'o', 'r', 'l', 'd'};

int main(void) {
  LOG_INIT();
  
  const struct device *const lora_dev = DEVICE_DT_GET(DT_ALIAS(lora0));
  struct lora_modem_config config;
  int ret;

  if (!device_is_ready(lora_dev)) {
    LOG_ERR("%s Device not ready", lora_dev->name);
    return 0;
  }

  config.frequency = 865000000;
  config.bandwidth = BW_125_KHZ;
  config.datarate = SF_8;
  config.preamble_len = 12;
  config.coding_rate = CR_4_5;
  config.iq_inverted = false;
  config.public_network = false;
  config.tx_power = 16;
  config.tx = true;

  ret = lora_config(lora_dev, &config);
  if (ret < 0) {
    LOG_ERR("LoRa config failed");
    return 0;
  }

  data[0] = '0';
  data[5] = '0';
  LOG_INF("Ready to start sending");

  while (1) {
    ret = lora_send(lora_dev, data, MAX_DATA_LEN);
    if (ret < 0) {
            LOG_ERR("LoRa send failed");
            return 0;
    }

    LOG_INF("Data sent!");

    /* Send data at 3s interval */
    k_sleep(K_MSEC(3000));

    data[0]++; data[5]++;
    if (data[5] > '9') { data[0] = '0'; data[5] = '0'; }
  }

	return 0;
}
```
